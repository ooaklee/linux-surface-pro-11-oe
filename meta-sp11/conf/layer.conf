## meta-sp11/conf/layer.conf
```bitbake
# Surface Pro 11 userspace integration layer.
BBPATH .= ":${LAYERDIR}"
BBFILES += "${LAYERDIR}/recipes-*/*/*.bb ${LAYERDIR}/recipes-*/*/*.bbappend"

BBFILE_COLLECTIONS += "sp11"
BBFILE_PATTERN_sp11 = "^${LAYERDIR}/"
BBFILE_PRIORITY_sp11 = "6"
LAYERVERSION_sp11 = "1"
LAYERSERIES_COMPAT_sp11 = "styhead walnascar whinlatter wrynose"
```
